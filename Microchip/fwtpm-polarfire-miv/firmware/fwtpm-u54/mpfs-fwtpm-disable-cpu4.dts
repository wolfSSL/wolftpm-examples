/* mpfs-fwtpm-disable-cpu4.dts
 *
 * Device tree overlay to disable cpu4 (U54 hart 4) for AMP fwTPM.
 * Hart 4 runs fwTPM in bare-metal M-mode; Linux must not schedule on it.
 *
 * Shared-memory reservation:
 *   - LIM_CACHED / L1D_OFF / IHC builds keep the fwTPM TIS mailbox +
 *     console ring in L2 LIM at 0x08000000 (16KB). LIM is not part of
 *     Linux's main DRAM map and needs no reserved-memory entry here.
 *   - The default DDR_WCB build places the live mailbox + console ring +
 *     TIS registers in the non-cached DDR window at 0xC0000000 (16KB).
 *     That window aliases physical DDR that Linux may also own, so it MUST
 *     be excluded from Linux's usable memory or hart 4 and Linux can clobber
 *     each other's pages. fragment@1 below now ships an ACTIVE
 *     reserved-memory/no-map carve-out for that region.
 *
 *     CONFIRM THE BASE FOR YOUR BOARD: the reg base must be the physical
 *     address that Linux allocates from which backs the 0xC0000000 window.
 *     On a design whose MSS seg map is identity for that window (Linux's
 *     /memory node spans 0xC0000000), 0xC0000000 is correct as shipped. If
 *     the non-cached window instead aliases the cached DRAM Linux allocates
 *     from at a different address, set reg to that cached-alias base instead
 *     -- a wrong base reserves the wrong pages and leaves the alias exposed.
 *     Verify on the target: read the reserved-memory reg under
 *     /proc/device-tree and check `/proc/iomem` against the design's MSS
 *     seg config. Until confirmed,
 *     FWTPM_XPORT=LIM_CACHED needs no reservation (LIM is outside DRAM).
 *
 * Compile: dtc -@ -I dts -O dtb -o mpfs-fwtpm-disable-cpu4.dtbo \
 *              mpfs-fwtpm-disable-cpu4.dts
 *
 * Deploy: copy .dtbo to the boot partition overlays/ directory.
 */

/dts-v1/;
/plugin/;

/ {
	compatible = "microchip,mpfs";

	fragment@0 {
		target = <&cpu4>;
		__overlay__ {
			status = "disabled";
		};
	};

	/* Reserve the 16KB DDR_WCB shared-memory region (FWTPM_TIS_SHM_SIZE)
	 * so Linux does not allocate the pages hart 4 uses for the mailbox +
	 * console ring + TIS registers. See the header comment: confirm the
	 * base against the board's MSS seg config before trusting it. */
	fragment@1 {
		target-path = "/";
		__overlay__ {
			reserved-memory {
				#address-cells = <2>;
				#size-cells = <2>;
				ranges;

				fwtpm_shm: fwtpm@c0000000 {
					reg = <0x0 0xc0000000 0x0 0x4000>;
					no-map;
				};
			};
		};
	};
};
